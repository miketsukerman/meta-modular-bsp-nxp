## conf/machine/ecu150a1.conf
```bitbake
#@TYPE: Machine
#@NAME: NXP i.MX 8M Quad ECU150A1
#@SOC: i.MX8MQ
#@DESCRIPTION: Machine configuration for NXP i.MX 8M Quad ECU150A1

MACHINEOVERRIDES =. "ecu150a1:"
#require conf/machine/include/imx-base.inc
#require conf/machine/include/arm/armv8a/tune-cortexa53.inc
require conf/machine/imx8mqevk.conf


DISTRO_FEATURES:remove = "sysvinit"

# BSP default providers
#PREFERRED_PROVIDER_virtual/kernel:ecu150a1 ?= "linux-imx"
#PREFERRED_PROVIDER_u-boot:ecu150a1 ?= "u-boot-adv"
#PREFERRED_PROVIDER_u-boot-fw-utils:ecu150a1 ?= "u-boot-fw-utils"
#PREFERRED_PROVIDER_virtual/bootloader:ecu150a1 ?= "u-boot-imx"

KERNEL_DEVICETREE:ecu150a1 = "freescale/ecu150a1.dtb"

MACHINE_EXTRA_RRECOMMENDS:remove = " imx-m4-demos"

UBOOT_CONFIG ??= "sd"
#UBOOT_CONFIG[sd] = "imx8mq_ecu150a1_defconfig,sdcard"
UBOOT_CONFIG[sd] = "imx8mq_evk_config,sdcard"
SPL_BINARY = "spl/u-boot-spl.bin"

ATF_PLATFORM = "imx8mq"

# Set DDR FIRMWARE
DDR_FIRMWARE_NAME = " \
    lpddr4_pmu_train_1d_imem.bin \
    lpddr4_pmu_train_1d_dmem.bin \
    lpddr4_pmu_train_2d_imem.bin \
    lpddr4_pmu_train_2d_dmem.bin \
"

# Set U-Boot DTB

UBOOT_DTB_NAME = "ecu150a1.dtb"

# Set imx-mkimage boot target
IMXBOOT_TARGETS = "flash_evk flash_evk_no_hdmi flash_dp_evk"
IMX_BOOT_SOC_TARGET = "iMX8M"

SERIAL_CONSOLES = "115200;ttymxc0"

IMAGE_BOOTLOADER = "imx-boot"

#ROOTFS_SIZE = "10000"
LOADADDR = ""
UBOOT_SUFFIX = "bin"
UBOOT_MAKE_TARGET = ""
IMX_BOOT_SEEK = "33"

# If you change TEE_LOAD_ADDR, make sure to align patch for soc.mak
TEE_LOAD_ADDR ?= "0x56000000"
TEE_CFG_DDR_SIZE ?= "0x100000000"

# Wayland based distros add systemd to DISTRO_FEATURES
# Remove sysvinit or systemd based on DISTRO_FEATURES to avoid conflicts
DISTRO_FEATURES_BACKFILL_CONSIDERED:append = "${@bb.utils.contains('DISTRO_FEATURES', 'systemd', ' sysvinit', '', d)}"
DISTRO_FEATURES_BACKFILL_CONSIDERED:append = "${@bb.utils.contains('DISTRO_FEATURES', 'sysvinit', ' systemd', '', d)}"

# Use bluez-alsa instead of pulseaudio
DISTRO_FEATURES_BACKFILL_CONSIDERED:append = " pulseaudio"

# Enable virtuailzation
DISTRO_FEATURES:append:mx8-nxp-bsp = " virtualization"
DISTRO_FEATURES:append:mx9-nxp-bsp = " virtualization"
```
