
#include "rom5721-db5901-lvds.dtsi"

/ {
};

&lvds_backlight0 {
	pwms = <&pwm4 0 5000000 0>;
};

&mipi_dsi {
        panel@0 {
                compatible = "lg,lp097x02";
                reg = <0>;
                backlight=<&lvds_backlight0>;
				panel-init-sequence = [
                                29 00 06 3C 01 05 00 03 00
                                29 00 06 14 01 03 00 00 00
                                29 00 06 64 01 04 00 00 00
                                29 00 06 68 01 04 00 00 00
                                29 00 06 6C 01 04 00 00 00
                                29 00 06 70 01 04 00 00 00
                                29 00 06 34 01 1F 00 00 00
                                29 00 06 10 02 1F 00 00 00
                                29 00 06 04 01 01 00 00 00
                                29 00 06 04 02 01 00 00 00
                                29 00 06 50 04 20 01 F0 03
                                29 00 06 54 04 0A 00 0A 00
                                29 00 06 58 04 00 04 2C 01
                                29 00 06 5C 04 04 00 04 00
                                29 00 06 60 04 00 03 1E 00
                                29 00 06 64 04 01 00 00 00
                                29 01 06 A0 04 06 80 44 00
                                29 00 06 A0 04 06 80 04 00
                                29 00 06 04 05 04 00 00 00
                                29 78 06 9C 04 31 00 00 00
		];
	};
};
